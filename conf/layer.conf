## conf/layer.conf
```bitbake
# We have a conf and classes directory, add to BBPATH
BBPATH .= ":${LAYERDIR}"

# We have recipes-* directories, add to BBFILES
BBFILES += "${LAYERDIR}/recipes-*/*/*.bb \
            ${LAYERDIR}/recipes-*/*/*.bbappend"

BBFILE_COLLECTIONS += "meta-tmoore3-raspberrypi"
BBFILE_PATTERN_meta-tmoore3-raspberrypi = "^${LAYERDIR}/"
BBFILE_PRIORITY_meta-tmoore3-raspberrypi = "10"

LAYERDEPENDS_meta-tmoore3-raspberrypi = "core"
LAYERSERIES_COMPAT_meta-tmoore3-raspberrypi = "kirkstone"
```
